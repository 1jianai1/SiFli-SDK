## customer/peripherals/wifi/Kconfig
```kconfig
menu "WiFi"
menuconfig AIC_WLAN_AIC8800D40L
    bool "WIFI mod aic8800d40"
    default n
    select LPKG_USING_MBEDTLS
    if AIC_WLAN_AIC8800D40L
    source "$SIFLI_SDK/customer/peripherals/wifi/aic8800d40/Kconfig"
    endif

menuconfig WIFI_USING_AIC8800MC
    bool  "AIC8800MC"
    default n
    if WIFI_USING_AIC8800MC
        config USING_AICXTEK_WIFI
            bool "Enable using aicxtek WIFI"
            default y
        if USING_AICXTEK_WIFI    

            config AIC_CFG_RDATA_MODE_EN
                bool "AIC_CFG_RDATA_MODE_EN"
                default n
            
            config AIC_CFG_VNET_MODE_EN
                bool "AIC_CFG_VNET_MODE_EN"
                default y
            choice
                prompt "hardware wifi interface type"
            
                config WIFI_INF_TYPE_SDIO
                    bool "SDIO interface sdio"
                config WIFI_INF_TYPE_SPI
                    bool "SDIO interface spi"    
                config WIFI_INF_TYPE_UART
                    bool "SDIO interface uart"     
            endchoice

            config AIC_ENABLE_P2P
                bool "Enable WiFi Direct (P2P) support"
                default n
                help
                    The default boot-time mode is STA. To start a P2P GO,
                    the application must first switch the wlan device to
                    AP mode:
                        rt_wlan_set_mode("wlan0", RT_WLAN_AP);

        endif
    endif

menuconfig BSP_WIFI_SWT6621
    bool "SWT6621"
    default n
    if BSP_WIFI_SWT6621
        config WIFI_WAKEUP_OUT_PIN
            int "SWT6621 WAKEUP OUT pin number"
            default 2
        config WIFI_WAKEUP_IN_PIN
            int "SWT6621 WAKEUP IN pin number" 
            default 5
        config WIFI_POWER_PIN
            int "SWT6621 POWER pin number"
            default 53
        config SKW_BOOT_MODE_RAM
            bool "wifi firmware load mode ram"
            default y  
        if !SKW_BOOT_MODE_RAM           
            config WIFI_DRAM_PATH
                string "WIFI fwk dram path"
                default "wifi/boot/SWT6621S_DRAM_SDIO.bin"
            config WIFI_IRAM_PATH
                string "WIFI fwk Iram path"
                default "wifi/boot/SWT6621S_IRAM_SDIO.bin"
            config WIFI_CALIBRATION_PATH
                string "WIFI fwk Iram path"
                default "wifi/calibration/SWT6621S_SEEKWAVE_R00000.bin"
        endif
        config SKW_WIFI_DEBUG
            bool "wifi debug file enable"
            default n
        if SKW_WIFI_DEBUG
            config WIFI_DEBUG_PATH
                string "wifi debug file path"
                default "wifi/debug"
        endif
        config WIFI_SDIO_NUM
            int "SWT6621 SDIO port number, 0-SDHCI1; 1-SDHCI2; 2-SDIO"
            default 0
    endif

menuconfig WIFI_USING_AIC8800_RTOS
    bool "AIC8800 RTOS driver (SDIO, customer/peripherals/wifi/aic8800_rtos_driver)"
    default n
    help
      AIC8800D80 SDIO WiFi: host 预编译库 (libaic8800_driver.a + libaic_mbedtls.a)
      + platform 适配层 (scons 编译)。路线1: 驱动自建 lwIP netif, 不依赖 rt_wlan。
    if WIFI_USING_AIC8800_RTOS

        config AIC8800_RTOS_WIRELESS_PWR_GPIO
            int "aic8800 wlan power-on gpio (WL_REG_ON, -1 = not used)"
            default -1
            help
              WiFi 芯片电源使能脚。驱动启动时按 拉低 -> 延时 -> 拉高 上电
              (若配置为 -1 则不做任何 GPIO 操作, 由硬件自行保证上电)。

        config AIC8800_USE_RT_WLAN
            bool "接入 RT-Thread Wi-Fi 管理框架 (rt_wlan + netdev)"
            default n
            select RT_USING_WIFI
            help
              开启: netif 由 rt_wlan 框架创建并注册进 netdev，驱动实现 rt_wlan_dev_ops，
              App 可用 rt_wlan_connect/scan/start_ap 标准 API；
              STA+AP+P2P 并发降级为单 STA 或单 AP（P2P 走私有路径不受影响）。
              关闭（默认）: 维持路线1，驱动自建 netif，并发能力完整。
    endif
endmenu
```
